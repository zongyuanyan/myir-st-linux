## Documentation/devicetree/bindings/display/panel/sitronix,st7701.txt
```
Sitronix ST7701 based LCD panels

ST7701 designed for small and medium sizes of TFT LCD display, is
capable of supporting up to 480RGBX864 in resolution. It provides
several system interfaces like MIPI/RGB/SPI.

Techstar TS8550B is 480x854, 2-lane MIPI DSI LCD panel which has
inbuilt ST7701 chip.

Required properties:
- compatible: must be "sitronix,st7701" and one of
  * "techstar,ts8550b"
- reset-gpios: a GPIO phandle for the reset pin

Required properties for techstar,ts8550b:
- reg: DSI virtual channel used by that screen
- VCC-supply: analog regulator for MIPI circuit
- IOVCC-supply: I/O system regulator

Optional properties:
- backlight: phandle for the backlight control.

panel@0 {
	compatible = "techstar,ts8550b", "sitronix,st7701";
	reg = <0>;
	VCC-supply = <&reg_dldo2>;
	IOVCC-supply = <&reg_dldo2>;
	reset-gpios = <&pio 3 24 GPIO_ACTIVE_HIGH>; /* LCD-RST: PD24 */
	backlight = <&backlight>;
};


/*only for myir myd-ya157c-v2*/
&spi1 {
	panel@0 {
		compatible = "sitronix,ST7701S";
		spi-max-frequency = <20000000>;
		reg = <0>;
		pinctrl-names = "default", "sleep";
		pinctrl-0 = <&ltdc_pins_a>;
		pinctrl-1 = <&ltdc_pins_sleep_a>;
		reset-gpio = <&gpioe 12 GPIO_ACTIVE_HIGH>;
		status = "okay";
		 port {
			panel_in: endpoint {
				 remote-endpoint = <&ltdc_ep0_out>;
				};
			};
      };
};

&ltdc {
        status = "okay";

        port {
                #address-cells = <1>;
                #size-cells = <0>;

                ltdc_ep0_out: endpoint@0 {
                                reg = <0>;
                                remote-endpoint = <&panel_in>;
                                };
           };
};
```
